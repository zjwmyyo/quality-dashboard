## ai-passport-qqmusic/firmware/main/Kconfig.projbuild
```kconfig
menu "QQ Music Player"
    config QQM_WIFI_SSID
        string "Wi-Fi 名称 (SSID)"
        default ""
        help
            AI Passport 要连接的 2.4GHz Wi-Fi 名称，需与运行后端的电脑同一局域网。

    config QQM_WIFI_PASSWORD
        string "Wi-Fi 密码"
        default ""

    config QQM_SERVER_URL
        string "后端服务器地址"
        default "http://192.168.1.100:3200"
        help
            运行 qqmusic-passport 后端的电脑地址，启动后端时屏幕/终端会打印局域网地址。
            格式 http://IP:端口，不要带末尾斜杠。

    config QQM_VOLUME
        int "播放音量 (0-100)"
        default 70
        range 0 100
endmenu
```

## ai-passport-qqmusic/firmware/sdkconfig.defaults
```kconfig
# --- 目标芯片 ---
CONFIG_IDF_TARGET="esp32c3"
# 注:ESP32-C3 无 PSRAM,故不设 CONFIG_SPIRAM。

# --- Flash ---
# FoloToy AI Passport 当前产品/固件基线使用 8MB Flash。
CONFIG_ESPTOOLPY_FLASHSIZE_8MB=y
# 固定 8MB 镜像头，关闭 detect，便于 idf.py merge-bin。
CONFIG_ESPTOOLPY_HEADER_FLASHSIZE_UPDATE=n
CONFIG_PARTITION_TABLE_CUSTOM=y
CONFIG_PARTITION_TABLE_CUSTOM_FILENAME="partitions.csv"
CONFIG_PARTITION_TABLE_FILENAME="partitions.csv"

# --- 控制台:USB-Serial-JTAG(C3 原生 USB,GPIO18/19)---
CONFIG_ESP_CONSOLE_USB_SERIAL_JTAG=y
CONFIG_ESP_CONSOLE_SECONDARY_NONE=y

# --- LVGL ---
CONFIG_LV_COLOR_DEPTH_16=y
CONFIG_LV_DEF_REFR_PERIOD=20
CONFIG_LV_FONT_MONTSERRAT_14=y
CONFIG_LV_FONT_MONTSERRAT_20=y
CONFIG_LV_FONT_FMT_TXT_LARGE=y
# 播放器界面含列表/进度条，给 LVGL 32KB 内存池。
CONFIG_LV_MEM_SIZE=32768

# --- 系统 ---
CONFIG_FREERTOS_HZ=1000
# 主任务栈加大（初始化阶段网络/字体占用较多）
CONFIG_ESP_MAIN_TASK_STACK_SIZE=4096

# --- Wi-Fi / 网络（流式播放防卡顿调优）---
CONFIG_ESP_WIFI_STATIC_RX_BUFFER_NUM=16
CONFIG_ESP_WIFI_DYNAMIC_RX_BUFFER_NUM=32
CONFIG_ESP_WIFI_DYNAMIC_TX_BUFFER_NUM=32
CONFIG_ESP_WIFI_AMPDU_TX_ENABLED=y
CONFIG_ESP_WIFI_AMPDU_RX_ENABLED=y
CONFIG_LWIP_TCP_RECVMBOX_SIZE=16
CONFIG_LWIP_TCP_SND_BUF_DEFAULT=16384
CONFIG_LWIP_TCP_WND_DEFAULT=32768
# 仅访问局域网 HTTP 后端，关闭 HTTPS 客户端以节省内存
CONFIG_ESP_HTTP_CLIENT_ENABLE_HTTPS=n

# --- 蓝牙：本应用不需要，关闭以释放内存 ---
CONFIG_BT_ENABLED=n

CONFIG_QQM_WIFI_SSID=""

CONFIG_QQM_WIFI_PASSWORD=""

CONFIG_QQM_SERVER_URL=""

CONFIG_QQM_VOLUME=70
```
